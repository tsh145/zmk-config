## config/boards/shields/tg5x/Kconfig.defconfig
```kconfig
# SPDX-License-Identifier: MIT

if SHIELD_TG5X

config ZMK_KEYBOARD_NAME
    default "TG5x"

config PWM
    default y

config LED_PWM
    default y

config PINCTRL
    default y

endif
```

## config/boards/shields/tg5x/Kconfig.shield
```kconfig
# SPDX-License-Identifier: MIT

config SHIELD_TG5X
    def_bool $(shields_list_contains,tg5x)
```
